## drivers/icc/Kconfig
```kconfig
#
# ICC character device configuration
#

menu "ICC character devices"
	#depends on POS_ICC

config ICC
	tristate "ICC card suppport"
	#depends on POS_ICC
	help
	  Enable support for the IC Card.

	  This driver may be built as a module ( = code which can be
	  inserted in and removed from the running kernel whenever you want).
	  The module will be called synclinkmp.  If you want to do that, say M
	  here.


config ICC_DEBUG
	tristate "ICC card debug function support"
	depends on  ICC
	help
	  Enable support for the IC Card reader.

endmenu
```

## kernel/drivers/mxc/security/Kconfig
```kconfig
menu "MXC Security Drivers"

config MXC_SECURITY_SCC
	tristate "MXC SCC Driver"
	default n
	---help---
	  This module contains the core API's for accessing the SCC module.
	  If you are unsure about this, say N here.

config MXC_SECURITY_SCC2
        tristate "MXC SCC2 Driver"
        depends on ARCH_MX37 || ARCH_MX51
        default n
        ---help---
          This module contains the core API's for accessing the SCC2 module.
          If you are unsure about this, say N here.

config SCC_DEBUG
        bool "MXC SCC Module debugging"
        depends on MXC_SECURITY_SCC || MXC_SECURITY_SCC2
        ---help---
        This is an option for use by developers; most people should
        say N here.  This enables SCC module debugging.

config MXC_SECURITY_RNG
	tristate "MXC RNG Driver"
	depends on ARCH_MXC
	depends on MXC_SECURITY_SCC
	depends on !ARCH_MXC91321
	depends on !ARCH_MX27
	default n
	select MXC_SECURITY_CORE
	---help---
	  This module contains the core API's for accessing the RNG module.
	  If you are unsure about this, say N here.

config MXC_RNG_TEST_DRIVER
	bool "MXC RNG debug register"
	depends on MXC_SECURITY_RNG
	default n
	---help---
	  This option enables the RNG kcore driver to provide peek-poke facility
	  into the RNG device registers. Enable this, only for development and
	  testing purposes.
config MXC_RNG_DEBUG
        bool "MXC RNG Module Dubugging"
        depends on MXC_SECURITY_RNG
        default n
        ---help---
         This is an option for use by developers; most people should
         say N here. This enables RNG module debugging.

config MXC_DRYICE
        tristate "MXC DryIce Driver"
        depends on ARCH_MX25
        default n
        ---help---
          This module contains the core API's for accessing the DryIce module.
          If you are unsure about this, say N here.

config MXC_KEYCRPT
       tristate "MXC KEYCRYPT Driver"
       depends on MXC_SECURITY_SCC
       depends on MXC_DRYICE
       default n  
       ---help---
         This module contains the core API for keycrypt module.
config MXC_FUSE_PROGRAM
       tristate "MXC FUSE PROGRAM"
       depends on ARCH_MX25
       default n  
       ---help---
         This module contains the core API for mx258 fuse program.
config MXC_RTIC
       tristate "MXC RTIC"
       depends on ARCH_MX25
       depends on MXC_DRYICE
       depends on MXC_SECURITY_SCC
       default n  
       ---help---
         This module contains the core API for mx258 fuse program.

if (ARCH_MX37 || ARCH_MX51 || ARCH_MX27)
source "drivers/mxc/security/sahara2/Kconfig"
endif

endmenu
```

## kernel/kernel/drivers/mxc/beep_backlight/Kconfig
```kconfig
#
# i.MX PWM Beep and Keyboard backlight driver.
#

menu "i.MX PWM Beep and Keyboard backlight support"

config IMX_BEEP_BACKLIGHT
	tristate "i.MX BEEP BACKLIGHT"
	default y
	help
	   This selects the Freescale i.MX PWM Beep and Keyboard backlight driver.

endmenu
```
